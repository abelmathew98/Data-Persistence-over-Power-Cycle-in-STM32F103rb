# file: stm32f103rb-datapersistence-flash.ioc
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Mcu.Family=STM32F1
Mcu.Name=STM32F103R(8-B)Tx
Mcu.Package=LQFP64
NVIC.PriorityGroup=NVIC_PRIORITYGROUP_4
PA13.Mode=Serial_Wire
PA13.Signal=SYS_JTMS-SWDIO
PA14.Mode=Serial_Wire
PA14.Signal=SYS_JTCK-SWCLK
ProjectManager.HeapSize=0x200
ProjectManager.StackSize=0x400
ProjectManager.TargetToolchain=STM32CubeIDE
RCC.AHBFreq_Value=36000000
RCC.APB1Freq_Value=36000000
RCC.APB1TimFreq_Value=36000000
RCC.APB2Freq_Value=36000000
RCC.APB2TimFreq_Value=36000000
RCC.HCLKFreq_Value=36000000
RCC.PLLMUL=RCC_PLL_MUL9
RCC.SYSCLKFreq_VALUE=36000000
RCC.SYSCLKSource=RCC_SYSCLKSOURCE_PLLCLK
RCC.USBFreq_Value=36000000
board=custom

// file: Core/Src/main.c
/* USER CODE BEGIN Header */
/**
  ******************************************************************************
  * @file           : main.c
  * @brief          : Main program body
  ******************************************************************************
  * @attention
  *
  * <h2><center>&copy; Copyright (c) 2021 STMicroelectronics.
  * All rights reserved.</center></h2>
  *
  * This software component is licensed by ST under BSD 3-Clause license,
  * the "License"; You may not use this file except in compliance with the
  * License. You may obtain a copy of the License at:
  *                        opensource.org/licenses/BSD-3-Clause
  *
  ******************************************************************************
  */
/* USER CODE END Header */
#include "main.h"

/* USER CODE BEGIN Includes */
#include<string.h>
/* USER CODE END Includes */

/* USER CODE BEGIN PD */
#define FLASH_STORAGE 0x08005000
#define page_size 0x400 //page size for STM32F103RB is 1KB
/* USER CODE END PD */

void SystemClock_Config(void);
static void MX_GPIO_Init(void);

/* USER CODE BEGIN 0 */
void flashSave(uint8_t* data)
{
	//normal stores the number of complete 4 bits in the total size
	// excess is used account for the excess bits that come other than the perfect bit.
	//if such an excess bit comes ,then an extra 4bit memory is allocated to the data in FLASH
	//sum of normal and excess makes up the total required size of data to be copied to FLASH (in 4 bits)

	uint8_t normal;
	normal= strlen((char*)data)/4;
	int excess=strlen((char *)data)%4?1:0;

	volatile uint32_t flashData[normal+excess];
	memset((uint8_t*)flashData,0,strlen((char*)flashData));
	strcpy((char*)flashData,(char*)data);

	int normal1=strlen((char*)flashData)/4;
	int excess1=strlen((char *)flashData)%4?1:0;
	volatile uint32_t data_length= normal1+excess1;

	int normal2=strlen((char*)data)/page_size;
	int excess2=strlen((char *)data)%page_size?1:0;
	volatile uint16_t pages= normal2+ excess2;
//	volatile uint32_t flashData[(strlen((char*)data)/4)	+ (int)((strlen((char*)data) % 4) != 0)];
//		memset((uint8_t*)flashData, 0, strlen((char*)flashData));
//		strcpy((char*)flashData, (char*)data);
//
//		volatile uint32_t data_length = (strlen((char*)flashData) / 4)
//										+ (int)((strlen((char*)flashData) % 4) != 0);
//		volatile uint16_t pages = (strlen((char*)data)/page_size)
//										+ (int)((strlen((char*)data)%page_size) != 0);

	/* ******* Unlock the FLash to enable the flash control register access ********/
	HAL_FLASH_Unlock();

	/* Allow Access to option bytes sector */
	HAL_FLASH_OB_Unlock();

	/*Fill EraseInit structure*/
	FLASH_EraseInitTypeDef EraseInitStruct;
	EraseInitStruct.TypeErase = FLASH_TYPEERASE_PAGES;
	EraseInitStruct.PageAddress = FLASH_STORAGE;
	EraseInitStruct.NbPages = pages;
	uint32_t PageError;

	volatile uint32_t counter_w=0, index=0;

	/* Erases the memory*/
	volatile HAL_StatusTypeDef status;
	status = HAL_FLASHEx_Erase(&EraseInitStruct, &PageError);

	/* Loop to write the data to the flash*/
	while(index <data_length)
	{
		if(status==HAL_OK)
		{
			status =HAL_FLASH_Program(FLASH_TYPEPROGRAM_WORD,FLASH_STORAGE+counter_w, flashData[index]);
			if(status==HAL_OK)
			{
				counter_w+=4;
				index++;
			}
		}
	}

	HAL_FLASH_OB_Lock();
	HAL_FLASH_Lock();

}

void flashRead(uint8_t* data)
{
	volatile uint32_t read_data;
	volatile uint32_t counter_r=0;
	while(read_data!=0xFFFFFFFF)
	{
		// 32 bit data being split into 8 bit to read
		read_data = *(uint32_t*)(FLASH_STORAGE + counter_r);
		if(read_data != 0xFFFFFFFF)
		{
			data[counter_r] = (uint8_t)read_data;
			data[counter_r + 1] = (uint8_t)(read_data >> 8);
			data[counter_r + 2] = (uint8_t)(read_data >> 16);
			data[counter_r + 3] = (uint8_t)(read_data >> 24);
			counter_r += 4;
		}
	}
}

/* USER CODE END 0 */

int main(void)
{

  /* MCU Configuration--------------------------------------------------------*/

  /* Reset of all peripherals, Initializes the Flash interface and the Systick. */
  HAL_Init();

  /* Configure the system clock */
  SystemClock_Config();

  /* Initialize all configured peripherals */
  MX_GPIO_Init();
  /* USER CODE BEGIN 2 */
  char data1[50];     /* data1 is for writing the data into  flash memory*/
  memset(data1,0,sizeof(data1));
  strcpy(data1,"This is a data persistence test.");

  flashSave((uint8_t*)write_data); // 8-bit pointer to point to the address

  char data2[50];  /* data2 is for reading the data from flash memory*/
  memset(data2,0,sizeof(data2));

  flashRead((uint8_t*)data2);
  /* USER CODE END 2 */

  /* Infinite loop */
  while (1)
  {

  }
}

void SystemClock_Config(void)
{
  RCC_OscInitTypeDef RCC_OscInitStruct = {0};
  RCC_ClkInitTypeDef RCC_ClkInitStruct = {0};

  /** Initializes the RCC Oscillators according to the specified parameters
  * in the RCC_OscInitTypeDef structure.
  */
  RCC_OscInitStruct.OscillatorType = RCC_OSCILLATORTYPE_HSI;
  RCC_OscInitStruct.HSIState = RCC_HSI_ON;
  RCC_OscInitStruct.HSICalibrationValue = RCC_HSICALIBRATION_DEFAULT;
  RCC_OscInitStruct.PLL.PLLState = RCC_PLL_ON;
  RCC_OscInitStruct.PLL.PLLSource = RCC_PLLSOURCE_HSI_DIV2;
  RCC_OscInitStruct.PLL.PLLMUL = RCC_PLL_MUL9;
  if (HAL_RCC_OscConfig(&RCC_OscInitStruct) != HAL_OK)
  {
    Error_Handler();
  }
  /** Initializes the CPU, AHB and APB buses clocks
  */
  RCC_ClkInitStruct.ClockType = RCC_CLOCKTYPE_HCLK|RCC_CLOCKTYPE_SYSCLK
                              |RCC_CLOCKTYPE_PCLK1|RCC_CLOCKTYPE_PCLK2;
  RCC_ClkInitStruct.SYSCLKSource = RCC_SYSCLKSOURCE_PLLCLK;
  RCC_ClkInitStruct.AHBCLKDivider = RCC_SYSCLK_DIV1;
  RCC_ClkInitStruct.APB1CLKDivider = RCC_HCLK_DIV1;
  RCC_ClkInitStruct.APB2CLKDivider = RCC_HCLK_DIV1;

  if (HAL_RCC_ClockConfig(&RCC_ClkInitStruct, FLASH_LATENCY_1) != HAL_OK)
  {
    Error_Handler();
  }
}

static void MX_GPIO_Init(void)
{

  /* GPIO Ports Clock Enable */
  __HAL_RCC_GPIOA_CLK_ENABLE();

}

void Error_Handler(void)
{
  __disable_irq();
  while (1)
  {
  }
}

/************************ (C) COPYRIGHT STMicroelectronics *****END OF FILE****/
